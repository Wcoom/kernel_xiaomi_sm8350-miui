## drivers/memcheck/Kconfig
```kconfig
config DFX_MEMCHECK
	depends on HW_LOGGER
	bool "DFX memory checker module"
	default n
	---help---
	  This feature support to memory leak check

config DFX_MEMCHECK_DETAIL
	depends on DFX_MEMCHECK
	bool "DFX memory checker detail info module"
	default n
	---help---
	  This feature support to get detailed mem info

config DFX_MEMCHECK_STACK
	depends on DFX_MEMCHECK
	bool "DFX memory checker stack info module"
	default n
	---help---
	  This feature support to get stack info
```

## drivers/memcheck/impl/Kconfig
```kconfig
config DFX_MEMCHECK_EXT
	depends on DFX_MEMCHECK
	bool "Dfx get ion mem info"
	default n
	help
		This option enables ion or gpu trace, needed by memleak check modules
		you can disable it if your chipset cannot support ion
		it depend on the ability of your chip
		we add this config for you to facilitate to close it

config DFX_MEMCHECK_TEST
	depends on DFX_MEMCHECK
	bool "MM page trace test"
	default n
	help
		This option enables mm page trace test, needed by mm page trace modules.
```
