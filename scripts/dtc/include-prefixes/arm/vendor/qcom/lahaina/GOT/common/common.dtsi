#include "../../common/common.dtsi"
#include "huawei_audio.dtsi"
#include "huawei-lcd.dtsi"
#include "huawei_tp.dtsi"
#include "huawei_charger.dtsi"
#include "huawei-vibrator.dtsi"
#include "huawei-sensor.dtsi"
#include "huawei_antenna_board_detect.dtsi"
#include "huawei_connectivity.dtsi"
#include "huawei_camera.dtsi"
#include "huawei_usb.dtsi"
#include "huawei_bsp.dtsi"
#include "huawei_led.dtsi"
