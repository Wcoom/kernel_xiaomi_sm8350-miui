#include "../../common/common.dtsi"
#include "huawei_audio.dtsi"
#include "huawei_bsp.dtsi"
#include "huawei_tp.dtsi"
#include "huawei_fp.dtsi"
#include "huawei_dp.dtsi"
#include "huawei_charger.dtsi"
#include "huawei-sensor.dtsi"
#include "huawei_fac.dtsi"
#include "huawei_mmc.dtsi"
#include "huawei_lcd_pinctrl.dtsi"
#include "huawei_usb.dtsi"
/*
 * Each set of pins contains the pin number and pins voltage
 * values, and must end with the names _num and _val.
 */
&gpio_check {
	/* 432 : GPIO124, tlmm BASE = 308 */
	/* 433 : GPIO125, tlmm BASE = 308 */
	/* 434 : GPIO126, tlmm BASE = 308 */
	/* 436 : GPIO128, tlmm BASE = 308 */
        /* 488 : GPIO180, tlmm BASE = 308 */
	buckle_num = "432 433 434 436 488";
	buckle_val = "0 0 0 0 0";
};
&sensorhub_ext_config {
    compatible = "huawei,sensorhub";
    acc_sensor_id = "1 65558";// acc:1;  acc1:65558:65558=0x10016
};
&drop_sensor_enable {
    compatible = "huawei,sensorhub_drop";
    enable_drop = "1";
};

&als_after_sale_TCS3718ALSPRX {
    compatible = "TCS3718ALSPRX";
    als_after_sale_product = <27>;
    als_after_sale_xl = <428>;
    als_after_sale_yl = <132>;
    als_after_sale_xr = <528>;
    als_after_sale_yr = <232>;
    als_after_sale_gamma = <0>;
	190_20f = "478,224,1,1,218,184,168,149,112,90,61,31,5";
	default = "478,224,1,1,218,184,168,149,112,90,61,31,5";
};