/* Copyright (c) 2013, The Linux Foundation. All rights reserved.
 *
 * This program is free software; you can redistribute it and/or modify
 * it under the terms of the GNU General Public License version 2 and
 * only version 2 as published by the Free Software Foundation.
 *
 * This program is distributed in the hope that it will be useful,
 * but WITHOUT ANY WARRANTY; without even the implied warranty of
 * MERCHANTABILITY or FITNESS FOR A PARTICULAR PURPOSE.  See the
 * GNU General Public License for more details.
 */

/*-------------------------------------------------------------------------
 * This file is autogenerated file using gcdb parser. Please do not edit it.
 * Update input XML file to add a new entry or update variable in this file
 * VERSION = 1.1
 *-----------------------------------------------------------------------*/
&mdss_mdp {
	dsi_pal_190_207_7p8_qcom: lcd_kit_pal_190_207_7p8_qcom {
		compatible = "190_207";
		lcd-kit,panel-name = "190_207 CMD 2480 x 2200";
		lcd-kit,panel-type = <0x02>;
		lcd-kit,panel-aod-high-brightness-cmds = <0x39 0x01 0x00 0x00 0x00 0x00 0x05 0x51 0x00 0x00 0x0F 0xFE
		0x05 0x01 0x00 0x00 0x00 0x00 0x01 0x6C>;
		lcd-kit,panel-aod-low-brightness-cmds = <0x39 0x01 0x00 0x00 0x00 0x00 0x05 0x51 0x00 0x00 0x02 0xA0
		0x05 0x01 0x00 0x00 0x00 0x00 0x01 0x6C>;
		lcd-kit,panel-aod-no-brightness-cmds = <0x39 0x01 0x00 0x00 0x00 0x00 0x05 0x51 0x00 0x00 0x00 0x00
		0x05 0x01 0x00 0x00 0x00 0x00 0x01 0x6C>;
		lcd-kit,panel-aod-middle-brightness-cmds = <0x39 0x01 0x00 0x00 0x00 0x00 0x05 0x51 0x00 0x00 0x0F 0x87
		0x05 0x01 0x00 0x00 0x00 0x00 0x01 0x6C>;
		lcd-kit,panel-bic-weight-cmds = <0x39 0x01 0x00 0x00 0x00 0x00 0x06 0xF0 0x55 0xAA 0x52 0x08 0x08
		0x39 0x01 0x00 0x00 0x00 0x00 0x13 0xCA 0x00 0x00 0x00 0x00 0x00 0x00 0x00 0x00 0x00 0x00 0x00 0x00 0x00 0x00 0x00 0x00 0x00 0x00
		0x39 0x01 0x00 0x00 0x00 0x00 0x13 0xCB 0x00 0x00 0x00 0x00 0x00 0x00 0x00 0x00 0x00 0x00 0x00 0x00 0x00 0x00 0x00 0x00 0x00 0x00
		0x39 0x01 0x00 0x00 0x00 0x00 0x13 0xCD 0x00 0x00 0x00 0x00 0x00 0x00 0x00 0x00 0x00 0x00 0x00 0x00 0x00 0x00 0x00 0x00 0x00 0x00
		0x39 0x01 0x00 0x00 0x00 0x00 0x06 0xF0 0x55 0xAA 0x52 0x00 0x00>;
		lcd-kit,panel-bic-weight-cmds-state = "dsi_hs_mode";
		lcd-kit,panel-bic-roi-cmds = <0x39 0x01 0x00 0x00 0x00 0x00 0x06 0xF0 0x55 0xAA 0x52 0x08 0x08
		0x39 0x01 0x00 0x00 0x00 0x00 0x08 0xD2 0x80 0x01 0x00 0x00 0x00 0x00 0x00
		0x39 0x01 0x00 0x00 0x00 0x00 0x06 0xF0 0x55 0xAA 0x52 0x00 0x00>;
		lcd-kit,panel-bic-roi-cmds-state = "dsi_hs_mode";
		lcd-kit,check-reg-on-cmds = <0x06 0x01 0x00 0x00 0x0a 0x00 0x01 0x0a>;
		lcd-kit,check-reg-on-value = <0x9c>;
		lcd-kit,check-aod-reg-on-cmds = <0x06 0x01 0x00 0x00 0x0a 0x00 0x01 0x0a>;
		lcd-kit,check-aod-reg-on-value = <0xdc>;
		lcd-kit,check-reg-off-cmds = <0x06 0x01 0x00 0x00 0x0a 0x00 0x01 0x0a>;
		lcd-kit,check-reg-off-value = <0x08>;
		lcd-kit,check-reg-on-cmds-state = "dsi_lp_mode";
		lcd-kit,check-aod-reg-on-cmds-state = "dsi_lp_mode";
		lcd-kit,check-reg-off-cmds-state = "dsi_lp_mode";
		lcd-kit,bl-after-frame = <0>;
		lcd-kit,cmd-async-support = <0>;
		lcd-kit,ap-aod-support = <1>;
		lcd-kit,check-reg-on-support = <0>;
		lcd-kit,check-reg-on-support-dsm-report = <0>;
		lcd-kit,check-aod-reg-on-support = <0>;
		lcd-kit,check-aod-reg-on-support-dsm-report = <0>;
		lcd-kit,check-reg-off-support = <0>;
		lcd-kit,check-reg-off-support-dsm-report = <0>;
		lcd-kit,vtc-line-no-reset = <1>;
		qcom,mdss-dsi-panel-type = "dsi_cmd_mode";
		qcom,mdss-pan-physical-width-dimension = <148>;
		qcom,mdss-pan-physical-height-dimension = <132>;
		qcom,dsi-ctrl-num = <0 1>;
		qcom,dsi-phy-num = <0 1>;
		qcom,panel-supply-entries = <&dsi_panel_pwr_supply>;
		qcom,mdss-dsi-virtual-channel-id = <0>;
		qcom,mdss-dsi-h-sync-pulse = <0>;
		qcom,mdss-dsi-bllp-eof-power-mode;
		qcom,mdss-dsi-bllp-power-mode;
		qcom,mdss-dsi-dma-schedule-line = <0>;
		qcom,mdss-dsi-bpp = <24>;
		qcom,mdss-dsi-color-order = "rgb_swap_rgb";
		qcom,mdss-dsi-underflow-color = <0xff>;
		qcom,mdss-dsi-border-color = <0>;
		qcom,mdss-dsi-traffic-mode = "burst_mode";
		qcom,mdss-dsi-lane-map = "lane_map_0123";
		qcom,mdss-dsi-lane-0-state;
		qcom,mdss-dsi-lane-1-state;
		qcom,mdss-dsi-lane-2-state;
		qcom,mdss-dsi-mdp-trigger = "none";
		qcom,mdss-dsi-dma-trigger = "trigger_sw";
		qcom,mdss-dsi-te-pin-select = <1>;
		qcom,mdss-dsi-wr-mem-start = <0x2c>;
		qcom,mdss-dsi-wr-mem-continue = <0x3c>;
		qcom,mdss-dsi-te-dcs-command = <1>;
		qcom,mdss-dsi-te-check-enable;
		qcom,mdss-dsi-te-using-te-pin;
		qcom,dsi-panel-gpio-address = <0x0F100000 0x1000>;
		qcom,dsi-panel-gpio-pins = <12 24 82>;
		qcom,dsi-panel-gpio-names = "reg-gpio", "reset-gpio", "platform-te-gpio";
		qcom,mdss-dsi-t-clk-post = <0>;
		qcom,mdss-dsi-t-clk-pre = <0>;
		qcom,dsi-select-clocks = "mux_byte_clk0", "mux_pixel_clk0", "cphy_byte_clk0", "cphy_pixel_clk0";
		qcom,panel-cphy-mode;
		qcom,mdss-dsi-stream = <0>;
		qcom,cmd-sync-wait-broadcast;
		lcd-kit,check-thread-support = <0>;
		lcd-kit,check-time-period = <5000>;
		lcd-kit,check-fold-support = <0>;
		lcd-kit,fold-low-power-support = <0>;
		lcd-kit,fold-height = <0>;
		lcd-kit,unfold-height = <0>;
		lcd-kit,power-support = <0>;
		lcd-kit,three-stage-poweron = <1>;
		lcd-kit,fold-lp-time = <0>;
		lcd-kit,fold-nolp-time = <0>;
		qcom,sublinks-count = <2>;
		qcom,lanes-per-sublink = <2>;
		qcom,mdss-dsi-panel-hdr-color-primaries = <14500 15500 32000 17000 15500 30000 8000 3000>;
		qcom,mdss-dsi-panel-peak-brightness = <4200000>;
		qcom,mdss-dsi-panel-blackness-level = <3230>;
		qcom,dynamic-mode-switch-type = "dynamic-resolution-switch-immediate";
		qcom,mdss-dsi-bl-pmic-control-type = "bl_ctrl_dcs";
		qcom,mdss-dsi-bl-min-level = <1>;
		qcom,mdss-dsi-bl-max-level = <1056>;
		qcom,esd-gpio-detect-num0 = <135>;
		qcom,esd-gpio-normal-value0 = <0>;
		qcom,esd-gpio-detect-num1 = <136>;
		qcom,esd-gpio-normal-value1 = <0>;
		qcom,mdss-dsi-panel-status-command = [06 01 00 00 00 00 01 0A
			06 01 00 00 00 00 01 03
			06 01 00 00 00 00 01 0D];
		qcom,mdss-dsi-panel-status-command-state = "dsi_lp_mode";
		qcom,mdss-dsi-panel-status-check-mode = "reg_read";
		qcom,mdss-dsi-panel-status-read-length = <1 1 1>;
		qcom,mdss-dsi-panel-status-value = <0x9C>,<0x01>, <0x00>;
		lcd-kit,power-on-stage = <2 1 1
				9 1 1
				1 1 10>;
		lcd-kit,lp-on-stage = <5 1 10
				5 0 10
				5 1 10
				7 1 0
				6 1 0
				8 1 0>;
		lcd-kit,lp-off-stage = <0 0 0>;
		lcd-kit,power-off-stage = <7 0 0
				6 0 0
				8 0 5
				5 0 1
				9 0 20>;
		lcd-kit,only-power-off-stage = <0 0 0>;
		lcd-kit,pt-support = <0>;
		lcd-kit,panel-on-always-reset = <0>;
		lcd-kit,lcd-vci = <1 13 3300000 3300000 3300000 10000 80>;
		lcd-kit,lcd-iovcc = <1 12 1850000 1850000 1850000 60700 80>;
		lcd-kit,lcd-vdd = <2 122 1200000>;
		lcd-kit,lcd-reset = <2 24 0>;
		lcd-kit,lcd-vci-name = "vdd";
		lcd-kit,lcd-iovcc-name = "vddio";
		lcd-kit,project-id-support = <0>;
		lcd-kit,default-project-id = "G21579250";
		lcd-kit,sn-code-support = <1>;
		lcd-kit,oem-info-support = <1>;
		lcd-kit,oem-barcode-2d-support = <1>;
		lcd-kit,oem-barcode-2d-num-offset = <0>;
		lcd-kit,barcode-2d-cmds = <0x39 0x01 0x00 0x00 0x0a 0x00 0x06 0xF0 0x55 0xAA 0x52 0x08 0x01
		0x14 0x01 0x00 0x00 0x0a 0x00 0x08 0xD6 0x00 0x00 0x00 0x00 0x00 0x00 0x00
		0x14 0x01 0x00 0x00 0x0a 0x00 0x02 0xBE 0x00
		0x14 0x01 0x00 0x00 0x0a 0x00 0x06 0xBF 0x00 0x00 0x00 0x00 0x00
		0x14 0x01 0x00 0x00 0x0a 0x00 0x07 0xD7 0x00 0x00 0x00 0x00 0x00 0x00>;
		lcd-kit,barcode-2d-cmds-state = "dsi_lp_mode";
		lcd-kit,panel-getblmaxnit-type = <0>;
		lcd-kit,panel-blmaxnit-min-value = <400>;
		lcd-kit,inversion-support = <0>;
		lcd-kit,panel-gpio-offset = <308>;
		lcd-kit,finger-unlock-state-support = <0>;
		lcd-kit,esd-reg-te-check = <0>;
		lcd-kit,dbv-stat-support = <1>;
		lcd-kit,min-hbm-dbv = <3516>;
		lcd-kit,panel-bl-max-nit = <450>;
		lcd-kit,panel-bl-min = <3>;
		lcd-kit,panel-bl-max = <4095>;
		lcd-kit,panel-bl-def = <2047>;
		lcd-kit,check-reg-support = <0>;
		lcd-kit,thp-proximity-support = <0>;
		lcd-kit,proximity-reset-delay-min = <65>;
		lcd-kit,backlight-cmds = <0x39 0x01 0x00 0x00 0x00 0x00 0x03 0x51 0x00 0x00>;
		lcd-kit,backlight-cmds-state = "dsi_lp_mode";
		lcd-kit,backlight-order = <0>;
		lcd-kit,backlight-need-sync = <1>;
		lcd-kit,fps-60-cmd = "vndservice call display.qservice 25 i32 0 i32 0";
		lcd-kit,fps-90-cmd = "vndservice call display.qservice 25 i32 2 i32 0";
		lcd-kit,fps-120-cmd = "vndservice call display.qservice 25 i32 1 i32 0";
		qcom,mdss-dsi-display-timings {
			timing@0 {
				qcom,mdss-dsi-panel-width = <1240>;
				qcom,mdss-dsi-panel-height = <2200>;
				qcom,mdss-dsi-h-front-porch = <41>;
				qcom,mdss-dsi-h-back-porch = <32>;
				qcom,mdss-dsi-h-pulse-width = <32>;
				qcom,mdss-dsi-h-sync-skew = <0>;
				qcom,mdss-dsi-v-front-porch = <16>;
				qcom,mdss-dsi-v-back-porch = <12>;
				qcom,mdss-dsi-v-pulse-width = <4>;
				qcom,mdss-dsi-panel-framerate = <60>;
				qcom,mdss-dsi-panel-phy-timings= [00 00 00 00 1C 12 02
				19 02 02 04 00 00 00];
				qcom,display-topology  = <2 2 2>;
				qcom,default-topology-index  = <0>;
				qcom,mdss-dsi-on-command = [39 01 00 00 00 00 06 F0 55 AA 52 00 00
		39 01 00 00 00 00 05 FF AA 55 A5 81
		15 01 00 00 00 00 02 6F 06
		15 01 00 00 00 00 02 F3 09
		39 01 00 00 00 00 05 FF AA 55 A5 00
		05 01 00 00 00 00 01 35
		15 01 00 00 00 00 02 53 20
		39 01 00 00 00 00 06 F0 55 AA 52 08 00
		15 01 00 00 00 00 02 6F 02
		15 01 00 00 00 00 02 B5 15
		39 01 00 00 00 00 06 F0 55 AA 52 08 01
		15 01 00 00 00 00 02 6F 01
		39 01 00 00 00 00 04 D2 00 55 33
		39 01 00 00 00 00 05 51 00 00 00 00
		39 01 00 00 00 00 05 2A 00 00 04 D7
		39 01 00 00 00 00 05 2B 00 00 08 97
		39 01 00 00 00 00 06 F0 55 AA 52 08 00
		15 01 00 00 00 00 02 6F 05
		39 01 00 00 00 00 06 B5 7F 00 1D 00 4F
		15 01 00 00 00 00 02 6F 10
		39 01 00 00 00 00 06 B5 1D 1D 1D 1D 1D
		15 01 00 00 00 00 02 82 B2
		15 01 00 00 00 00 02 03 01
		15 01 00 00 00 00 02 90 01
		39 01 00 00 00 00 13 91 A9 28 00 32 C2 00 03 6D 05 F5 00 11 01 F6 00 E4 11 00
		05 01 00 00 00 00 01 2C
		15 01 00 00 00 00 02 2F 01
		39 01 00 00 00 00 06 F0 55 AA 52 08 00
		39 01 00 00 00 00 03 BE 0E 14
		39 01 00 00 00 00 06 F0 55 AA 52 08 01
		39 01 00 00 00 00 04 D1 06 00 18
		39 01 00 00 00 00 06 F0 55 AA 52 00 00
		05 01 00 00 78 00 01 11
		39 01 00 00 00 00 06 F0 55 AA 52 08 00
		15 01 00 00 00 00 02 C0 7E
		39 01 00 00 00 00 06 F0 55 AA 52 08 04
		15 01 00 00 00 00 02 C2 44
		39 01 00 00 00 00 06 F0 55 AA 52 08 08
		39 01 00 00 00 00 06 C1 23 80 00 01 01
		15 01 00 00 00 00 02 C6 03
		39 01 00 00 00 00 13 CA 00 0F 00 00 00 00 00 00 00 00 00 00 00 00 00 00 00 00
		39 01 00 00 00 00 13 CB 00 0F 00 00 00 00 00 00 00 00 00 00 00 00 00 00 00 00
		39 01 00 00 00 00 13 CD 00 0F 00 00 00 00 00 00 00 00 00 00 00 00 00 00 00 00
		39 01 00 00 00 00 08 D2 80 01 00 00 9B 00 92
		39 01 00 00 00 00 05 67 FF FF FF FF
		39 01 00 00 00 00 06 F0 55 AA 52 00 00
		05 01 00 00 14 00 01 29
		05 01 00 00 00 00 01 6C];
				qcom,mdss-dsi-on-command-state = "dsi_lp_mode";
				qcom,mdss-dsi-off-command = [05 01 00 00 00 00 01 38
		05 01 00 00 22 00 01 6C
		39 01 00 00 00 00 05 51 00 00 00 00
		05 01 00 00 00 00 01 6C
		05 01 00 00 14 00 01 28
		05 01 00 00 64 00 01 10
		05 01 00 00 00 00 01 6C
		15 01 00 00 00 00 02 4F 01];
				qcom,mdss-dsi-off-command-state = "dsi_lp_mode";
				qcom,compression-mode = "dsc";
				qcom,mdss-dsc-slice-height = <50>;
				qcom,mdss-dsc-slice-width = <1240>;
				qcom,mdss-dsc-slice-per-pkt = <1>;
				qcom,mdss-dsc-bit-per-component = <10>;
				qcom,mdss-dsc-bit-per-pixel = <8>;
				qcom,mdss-dsc-block-prediction-enable;
				qcom,mdss-dsi-lp1-command = [15 01 00 00 00 00 02 2F 01
		05 01 00 00 00 00 01 39
		05 01 00 00 00 00 01 2C
		05 01 00 00 00 00 01 6C];
				qcom,mdss-dsi-lp1-command-state = "dsi_lp_mode";
				qcom,mdss-dsi-nolp-command = [05 01 00 00 00 00 01 38
		05 01 00 00 22 00 01 6C
		15 01 00 00 00 00 02 2F 01];
				qcom,mdss-dsi-nolp-command-state = "dsi_lp_mode";
			};
		};
    };
};