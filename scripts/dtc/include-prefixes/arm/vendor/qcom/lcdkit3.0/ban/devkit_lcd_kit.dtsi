/*---------------------------------------------------------------------------
 * This file is autogenerated file using huawei LCD parser. Please do not edit it.
 * Update input XML file to add a new entry or update variable in this file
 * Parser location: vendor/huawei/chipset_common/devkit/lcdkit/tools 
 *---------------------------------------------------------------------------*/


#include "ban_190_207_6p85_qcom.dtsi"
#include "ban_190_20f_6p85_qcom.dtsi"
#include "ban_190_c04_1p04_qcom.dtsi"
#include "ban_190_c05_1p04_qcom.dtsi"
#include "ban_190_d02_1p04_qcom.dtsi"
#include "ban_190_d03_1p04_qcom.dtsi"
#include "ban_310_207_6p85_qcom.dtsi"
#include "ban_auo_def_6p85_qcom.dtsi"
#include "ban_sec_def_1p04_qcom.dtsi"