/*---------------------------------------------------------------------------
 * This file is autogenerated file using huawei LCD parser. Please do not edit it.
 * Update input XML file to add a new entry or update variable in this file
 * Parser location: vendor/huawei/chipset_common/devkit/lcdkit/tools 
 *---------------------------------------------------------------------------*/


#include "cel_190_207_6p699_qcom.dtsi"
#include "cel_190_c07_6p699_qcom.dtsi"
#include "cel_310_207_6p699_qcom.dtsi"
#include "cel_310_c07_6p699_qcom.dtsi"
#include "cel_310_f00_6p699_qcom.dtsi"
#include "cel_auo_otm1901a_5p2_1080p_video_default.dtsi"