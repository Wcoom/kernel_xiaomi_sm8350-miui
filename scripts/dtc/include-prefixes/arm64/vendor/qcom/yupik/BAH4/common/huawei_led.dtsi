&pm8350c_rgb {
    red {
                leds_disting = "true";
                cust_brightness = <100>;
        };

    green {
                leds_disting = "true";
                cust_brightness = <100>;
          };
};
