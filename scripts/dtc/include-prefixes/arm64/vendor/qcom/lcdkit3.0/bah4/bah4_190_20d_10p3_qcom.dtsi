/* Copyright (c) 2013, The Linux Foundation. All rights reserved.
 *
 * This program is free software; you can redistribute it and/or modify
 * it under the terms of the GNU General Public License version 2 and
 * only version 2 as published by the Free Software Foundation.
 *
 * This program is distributed in the hope that it will be useful,
 * but WITHOUT ANY WARRANTY; without even the implied warranty of
 * MERCHANTABILITY or FITNESS FOR A PARTICULAR PURPOSE.  See the
 * GNU General Public License for more details.
 */

/*-------------------------------------------------------------------------
 * This file is autogenerated file using gcdb parser. Please do not edit it.
 * Update input XML file to add a new entry or update variable in this file
 * VERSION = 1.1
 *-----------------------------------------------------------------------*/
&mdss_mdp {
	dsi_bah4_190_20d_10p3_qcom: lcd_kit_bah4_190_20d_10p3_qcom {
		compatible = "190_20d_10p3";
		lcd-kit,panel-name = "BAH4_190 20d 0 10.3' 1200 x 2000";
		lcd-kit,panel-type = <0x01>;
		lcd-kit,panel-xres = <1200>;
		lcd-kit,panel-yres = <2000>;
		lcd-kit,check-reg-on-cmds = <0x06 0x01 0x00 0x00 0x0a 0x00 0x01 0x0a>;
		lcd-kit,check-reg-on-value = <0x9c>;
		lcd-kit,check-aod-reg-on-cmds = <0x06 0x01 0x00 0x00 0x0a 0x00 0x01 0x0a>;
		lcd-kit,check-aod-reg-on-value = <0xdc>;
		lcd-kit,check-reg-off-cmds = <0x06 0x01 0x00 0x00 0x0a 0x00 0x01 0x0a>;
		lcd-kit,check-reg-off-value = <0x08>;
		lcd-kit,check-reg-on-cmds-state = "dsi_lp_mode";
		lcd-kit,check-aod-reg-on-cmds-state = "dsi_lp_mode";
		lcd-kit,check-reg-off-cmds-state = "dsi_lp_mode";
		lcd-kit,project-id-cmds = [15 01 00 00 0a 00 02 FF 22
			06 01 00 00 0a 00 01 00
			06 01 00 00 0a 00 01 01
			06 01 00 00 0a 00 01 02
			06 01 00 00 0a 00 01 03
			06 01 00 00 0a 00 01 04
			06 01 00 00 0a 00 01 05
			06 01 00 00 0a 00 01 06
			06 01 00 00 0a 00 01 07
			06 01 00 00 0a 00 01 08
			06 01 00 00 0a 00 01 09
			15 01 00 00 0a 00 02 FF 10];
		lcd-kit,project-id-cmds-state = "dsi_lp_mode";
		lcd-kit,hor-line-cmds = <0x15 0x01 0x00 0x00 0x00 0x00 0x02 0xFF 0x27
			0x15 0x01 0x00 0x00 0x00 0x00 0x02 0xFB 0x01
			0x15 0x01 0x00 0x00 0x00 0x00 0x02 0xD0 0x11
			0x15 0x01 0x00 0x00 0x00 0x00 0x02 0xD2 0x50
			0x15 0x01 0x00 0x00 0x00 0x00 0x02 0xDE 0x43
			0x15 0x01 0x00 0x00 0x00 0x00 0x02 0xDF 0x02
			0x15 0x01 0x00 0x00 0x00 0x00 0x02 0xFF 0x26
			0x15 0x01 0x00 0x00 0x00 0x00 0x02 0xFB 0x01
			0x15 0x01 0x00 0x00 0x00 0x00 0x02 0x02 0x21
			0x15 0x01 0x00 0x00 0x00 0x00 0x02 0x31 0x05
			0x15 0x01 0x00 0x00 0x00 0x00 0x02 0x32 0xD5
			0x15 0x01 0x00 0x00 0x00 0x00 0x02 0xFF 0x2A
			0x15 0x01 0x00 0x00 0x00 0x00 0x02 0xFB 0x01
			0x15 0x01 0x00 0x00 0x00 0x00 0x02 0xF1 0x04
			0x15 0x01 0x00 0x00 0x00 0x00 0x02 0xFF 0xD0
			0x15 0x01 0x00 0x00 0x00 0x00 0x02 0xFB 0x01
			0x15 0x01 0x00 0x00 0x00 0x00 0x02 0x02 0xA5
			0x15 0x01 0x00 0x00 0x00 0x00 0x02 0xFF 0xE0
			0x15 0x01 0x00 0x00 0x00 0x00 0x02 0xFB 0x01
			0x15 0x01 0x00 0x00 0x00 0x00 0x02 0x14 0x60
			0x15 0x01 0x00 0x00 0x00 0x00 0x02 0x16 0xC0
			0x15 0x01 0x00 0x00 0x00 0x00 0x02 0xFF 0xF0
			0x15 0x01 0x00 0x00 0x00 0x00 0x02 0xFB 0x01
			0x15 0x01 0x00 0x00 0x00 0x00 0x02 0x3A 0x08
			0x15 0x01 0x00 0x00 0x00 0x00 0x02 0xFF 0x10
			0x15 0x01 0x00 0x00 0x00 0x00 0x02 0xFB 0x01
			0x15 0x01 0x00 0x00 0x00 0x00 0x02 0xB9 0x01
			0x15 0x01 0x00 0x00 0x00 0x00 0x02 0xFF 0x20
			0x15 0x01 0x00 0x00 0x00 0x00 0x02 0xFB 0x01
			0x15 0x01 0x00 0x00 0x00 0x00 0x02 0x18 0x40
			0x15 0x01 0x00 0x00 0x00 0x00 0x02 0xFF 0x10
			0x15 0x01 0x00 0x00 0x00 0x00 0x02 0xFB 0x01
			0x15 0x01 0x00 0x00 0x00 0x00 0x02 0xB9 0x02
			0x15 0x01 0x00 0x00 0x00 0x00 0x02 0x35 0x00
			0x15 0x01 0x00 0x00 0x00 0x00 0x02 0xBB 0x13
			0x39 0x01 0x00 0x00 0x00 0x00 0x06 0x3B 0x03 0x74 0x1A 0x04 0x04
			0x15 0x01 0x00 0x00 0x00 0x00 0x02 0xB0 0x01
			0x15 0x01 0x00 0x00 0x00 0x00 0x02 0xFF 0x25
			0x15 0x01 0x00 0x00 0x00 0x00 0x02 0xFB 0x01
			0x15 0x01 0x00 0x00 0x00 0x00 0x02 0xEC 0x01
			0x15 0x01 0x00 0x00 0x00 0x00 0x02 0xFF 0xF0
			0x15 0x01 0x00 0x00 0x00 0x00 0x02 0xFB 0x01
			0x15 0x01 0x00 0x00 0x00 0x00 0x02 0x84 0x08
			0x15 0x01 0x00 0x00 0x00 0x00 0x02 0x85 0x0C
			0x15 0x01 0x00 0x00 0x00 0x00 0x02 0xFF 0x20
			0x15 0x01 0x00 0x00 0x00 0x00 0x02 0xFB 0x01
			0x15 0x01 0x00 0x00 0x00 0x00 0x02 0x51 0x10
			0x15 0x01 0x00 0x00 0x00 0x00 0x02 0xFF 0x25
			0x15 0x01 0x00 0x00 0x00 0x00 0x02 0xFB 0x01
			0x15 0x01 0x00 0x00 0x00 0x00 0x02 0x91 0x1F
			0x15 0x01 0x00 0x00 0x00 0x00 0x02 0x92 0x0F
			0x15 0x01 0x00 0x00 0x00 0x00 0x02 0x93 0x01
			0x15 0x01 0x00 0x00 0x00 0x00 0x02 0x94 0x18
			0x15 0x01 0x00 0x00 0x00 0x00 0x02 0x95 0x03
			0x15 0x01 0x00 0x00 0x00 0x00 0x02 0x96 0x01
			0x15 0x01 0x00 0x00 0x00 0x00 0x02 0xFF 0x10>;
		lcd-kit,hor-line-cmds-state = "dsi_lp_mode";
		lcd-kit,vtc-line-cmds = <0x15 0x01 0x00 0x00 0x00 0x00 0x02 0xFF 0x27
			0x15 0x01 0x00 0x00 0x00 0x00 0x02 0xFB 0x01
			0x15 0x01 0x00 0x00 0x00 0x00 0x02 0xD0 0x11
			0x15 0x01 0x00 0x00 0x00 0x00 0x02 0xD2 0x50
			0x15 0x01 0x00 0x00 0x00 0x00 0x02 0xDE 0x43
			0x15 0x01 0x00 0x00 0x00 0x00 0x02 0xDF 0x02
			0x15 0x01 0x00 0x00 0x00 0x00 0x02 0xFF 0x26
			0x15 0x01 0x00 0x00 0x00 0x00 0x02 0xFB 0x01
			0x15 0x01 0x00 0x00 0x00 0x00 0x02 0x02 0x21
			0x15 0x01 0x00 0x00 0x00 0x00 0x02 0x31 0x05
			0x15 0x01 0x00 0x00 0x00 0x00 0x02 0x32 0xD5
			0x15 0x01 0x00 0x00 0x00 0x00 0x02 0xFF 0x2A
			0x15 0x01 0x00 0x00 0x00 0x00 0x02 0xFB 0x01
			0x15 0x01 0x00 0x00 0x00 0x00 0x02 0xF1 0x04
			0x15 0x01 0x00 0x00 0x00 0x00 0x02 0xFF 0xD0
			0x15 0x01 0x00 0x00 0x00 0x00 0x02 0xFB 0x01
			0x15 0x01 0x00 0x00 0x00 0x00 0x02 0x02 0xA5
			0x15 0x01 0x00 0x00 0x00 0x00 0x02 0xFF 0xE0
			0x15 0x01 0x00 0x00 0x00 0x00 0x02 0xFB 0x01
			0x15 0x01 0x00 0x00 0x00 0x00 0x02 0x14 0x60
			0x15 0x01 0x00 0x00 0x00 0x00 0x02 0x16 0xC0
			0x15 0x01 0x00 0x00 0x00 0x00 0x02 0xFF 0xF0
			0x15 0x01 0x00 0x00 0x00 0x00 0x02 0xFB 0x01
			0x15 0x01 0x00 0x00 0x00 0x00 0x02 0x3A 0x08
			0x15 0x01 0x00 0x00 0x00 0x00 0x02 0xFF 0x10
			0x15 0x01 0x00 0x00 0x00 0x00 0x02 0xFB 0x01
			0x15 0x01 0x00 0x00 0x00 0x00 0x02 0xB9 0x01
			0x15 0x01 0x00 0x00 0x00 0x00 0x02 0xFF 0x20
			0x15 0x01 0x00 0x00 0x00 0x00 0x02 0xFB 0x01
			0x15 0x01 0x00 0x00 0x00 0x00 0x02 0x18 0x40
			0x15 0x01 0x00 0x00 0x00 0x00 0x02 0xFF 0x10
			0x15 0x01 0x00 0x00 0x00 0x00 0x02 0xFB 0x01
			0x15 0x01 0x00 0x00 0x00 0x00 0x02 0xB9 0x02
			0x15 0x01 0x00 0x00 0x00 0x00 0x02 0x35 0x00
			0x15 0x01 0x00 0x00 0x00 0x00 0x02 0xBB 0x13
			0x39 0x01 0x00 0x00 0x00 0x00 0x06 0x3B 0x03 0x74 0x1A 0x04 0x04
			0x15 0x01 0x00 0x00 0x00 0x00 0x02 0xB0 0x01
			0x05 0x01 0x00 0x00 0x78 0x00 0x01 0x11
			0x05 0x01 0x00 0x00 0x14 0x00 0x01 0x29
			0x15 0x01 0x00 0x00 0x00 0x00 0x02 0xFF 0xF0
			0x15 0x01 0x00 0x00 0x00 0x00 0x02 0xFB 0x01
			0x15 0x01 0x00 0x00 0x00 0x00 0x02 0x84 0x08
			0x15 0x01 0x00 0x00 0x00 0x00 0x02 0x85 0x0C
			0x15 0x01 0x00 0x00 0x00 0x00 0x02 0xFF 0x20
			0x15 0x01 0x00 0x00 0x00 0x00 0x02 0xFB 0x01
			0x15 0x01 0x00 0x00 0x00 0x00 0x02 0x51 0x10
			0x15 0x01 0x00 0x00 0x00 0x00 0x02 0xFF 0x25
			0x15 0x01 0x00 0x00 0x00 0x00 0x02 0xFB 0x01
			0x15 0x01 0x00 0x00 0x00 0x00 0x02 0x91 0x1F
			0x15 0x01 0x00 0x00 0x00 0x00 0x02 0x92 0x0F
			0x15 0x01 0x00 0x00 0x00 0x00 0x02 0x93 0x01
			0x15 0x01 0x00 0x00 0x00 0x00 0x02 0x94 0x18
			0x15 0x01 0x00 0x00 0x00 0x00 0x02 0x95 0x03
			0x15 0x01 0x00 0x00 0x00 0x00 0x02 0x96 0x01
			0x15 0x01 0x00 0x00 0x00 0x00 0x02 0xFF 0x10>;
		lcd-kit,vtc-line-cmds-state  = "dsi_lp_mode";
		lcd-kit,bl-after-frame = <0>;
		lcd-kit,cmd-async-support = <0>;
		lcd-kit,check-reg-on-support = <0>;
		lcd-kit,check-reg-on-support-dsm-report = <0>;
		lcd-kit,check-aod-reg-on-support = <0>;
		lcd-kit,check-aod-reg-on-support-dsm-report = <0>;
		lcd-kit,check-reg-off-support = <0>;
		lcd-kit,check-reg-off-support-dsm-report = <0>;
		lcd-kit,vtc-line-support = <1>;
		lcd-kit,hor-line-support = <1>;
		lcd-kit,hor-line-duration = <600>;
		lcd-kit,vtc-line-no-reset = <1>;
		qcom,mdss-dsi-panel-type = "dsi_video_mode";
		qcom,mdss-pan-physical-width-dimension = <136>;
		qcom,mdss-pan-physical-height-dimension = <226>;
		qcom,dsi-ctrl-num = <0>;
		qcom,dsi-phy-num = <0>;
		qcom,panel-supply-entries = <&dsi_panel_pwr_supply>;
		qcom,mdss-dsi-virtual-channel-id = <0>;
		qcom,mdss-dsi-h-sync-pulse = <0>;
		qcom,mdss-dsi-bllp-eof-power-mode;
		qcom,mdss-dsi-bllp-power-mode;
		qcom,mdss-dsi-dma-schedule-line = <1>;
		qcom,mdss-dsi-bpp = <24>;
		qcom,mdss-dsi-color-order = "rgb_swap_rgb";
		qcom,mdss-dsi-underflow-color = <0xff>;
		qcom,mdss-dsi-border-color = <0>;
		qcom,mdss-dsi-traffic-mode = "burst_mode";
		qcom,mdss-dsi-lane-map = "lane_map_0123";
		qcom,mdss-dsi-lane-0-state;
		qcom,mdss-dsi-lane-1-state;
		qcom,mdss-dsi-lane-2-state;
		qcom,mdss-dsi-lane-3-state;
		qcom,mdss-dsi-mdp-trigger = "none";
		qcom,mdss-dsi-dma-trigger = "trigger_sw";
		qcom,mdss-dsi-te-pin-select = <0>;
		qcom,mdss-dsi-t-clk-post = <0x0D>;
		qcom,mdss-dsi-t-clk-pre = <0x1B>;
		qcom,dsi-select-clocks = "mux_byte_clk0", "mux_pixel_clk0";
		qcom,mdss-dsi-stream = <0>;
		lcd-kit,check-thread-support = <0>;
		lcd-kit,check-time-period = <5000>;
		lcd-kit,check-fold-support = <0>;
		lcd-kit,fold-low-power-support = <0>;
		lcd-kit,fold-height = <0>;
		lcd-kit,unfold-height = <0>;
		lcd-kit,power-support = <0>;
		lcd-kit,three-stage-poweron = <1>;
		qcom,apaod-lp2-need-sendcmd;
		lcd-kit,fold-lp-time = <0>;
		lcd-kit,fold-nolp-time = <0>;
		qcom,sublinks-count = <2>;
		qcom,lanes-per-sublink = <2>;
		qcom,mdss-dsi-panel-hdr-color-primaries = <14500 15500 32000 17000 15500 30000 8000 3000>;
		qcom,mdss-dsi-panel-peak-brightness = <4200000>;
		qcom,mdss-dsi-panel-blackness-level = <3230>;
		qcom,dynamic-mode-switch-type = "dynamic-resolution-switch-immediate";
		qcom,mdss-dsi-bl-pmic-control-type = "bl_ctrl_i2c_ic";
		qcom,tp-suspend-before-lcd;
		qcom,esd-check-enabled;
		qcom,tp-esd-gpio-event;
		qcom,esd-gpio-detect-support;
		qcom,esd-gpio-detect-num0 = <96>;
		qcom,esd-gpio-normal-value0 = <0>;
		qcom,mdss-dsi-panel-status-command = [15 01 00 00 00 00 02 FF 10
			15 01 00 00 00 00 02 FB 01
			15 01 00 00 00 00 02 B9 03
			15 01 00 00 00 00 02 FF 25
			15 01 00 00 00 00 02 FB 01
			06 01 00 00 00 00 01 BB
			15 01 00 00 00 00 02 FF 10
			15 01 00 00 00 00 02 FB 01
			15 01 00 00 00 00 02 B9 02
			15 01 00 00 00 00 02 FF 25
			15 01 00 00 00 00 02 FB 01
			06 01 00 00 00 00 01 BB];
		qcom,mdss-dsi-panel-status-command-state = "dsi_lp_mode";
		qcom,mdss-dsi-panel-status-check-mode = "reg_read";
		qcom,mdss-dsi-panel-status-read-length = <0 0 0 0 0 1 0 0 0 0 0 1>;
		qcom,mdss-dsi-panel-status-value = <0x00>, <0x00>;
		lcd-kit,power-on-stage = <2 1 2>;
		lcd-kit,lp-on-stage = <3 1 5
				4 1 5
				11 1 15
				5 2 5
				5 1 5
				5 2 5
				5 1 55
				7 1 5
				6 1 0
				8 1 0>;
		lcd-kit,hs-off-stage = <7 0 0
				8 0 50>;
		lcd-kit,power-off-stage = <6 0 5
				5 0 5
				11 0 5
				4 0 5
				3 0 5
				2 0 0>;
		lcd-kit,pt-support = <0>;
		lcd-kit,panel-on-always-reset = <1>;
		lcd-kit,lcd-iovcc = <1 12 1900000 1900000 1900000 60700 80>;
		lcd-kit,lcd-vsp = <2 46 6000000>;
		lcd-kit,lcd-vsn = <2 62 6000000>;
		lcd-kit,lcd-reset = <2 44 0>;
		lcd-kit,lcd-iovcc-name = "vddio";
		lcd-kit,project-id-support = <1>;
		lcd-kit,default-project-id = "W1699Z1300";
		lcd-kit,Does-lcd-poweron-tp = <1>;
		lcd-kit,sn-code-support = <0>;
		lcd-kit,oem-info-support = <0>;
		lcd-kit,oem-barcode-2d-support = <0>;
		lcd-kit,oem-barcode-2d-num-offset = <0>;
		lcd-kit,panel-getblmaxnit-type = <0>;
		lcd-kit,panel-blmaxnit-min-value = <400>;
		lcd-kit,inversion-support = <0>;
		lcd-kit,panel-gpio-offset = <336>;
		lcd-kit,finger-unlock-state-support = <0>;
		lcd-kit,esd-reg-te-check = <0>;
		lcd-kit,panel-bl-max-nit = <450>;
		lcd-kit,panel-bl-min = <50>;
		lcd-kit,panel-bl-max = <3932>;
		lcd-kit,panel-bl-def = <128>;
		lcd-kit,check-reg-support = <0>;
		lcd-kit,thp-proximity-support = <0>;
		lcd-kit,proximity-reset-delay-min = <65>;
		lcd-kit,lcd-power-down-vsp = <2 46 4700000>;
		lcd-kit,lcd-power-down-vsn = <2 62 4700000>;
		lcd-kit,backlight-order = <0>;
		lcd-kit,backlight-need-sync = <0>;
		lcd-kit,fps-60-cmd = "vndservice call display.qservice 25 i32 0 i32 0";
		lcd-kit,fps-90-cmd = "vndservice call display.qservice 25 i32 2 i32 0";
		lcd-kit,fps-120-cmd = "vndservice call display.qservice 25 i32 1 i32 0";
		qcom,mdss-dsi-display-timings {
			timing@0 {
				qcom,mdss-dsi-panel-width = <1200>;
				qcom,mdss-dsi-panel-height = <2000>;
				qcom,mdss-dsi-h-front-porch = <20>;
				qcom,mdss-dsi-h-back-porch = <37>;
				qcom,mdss-dsi-h-pulse-width = <4>;
				qcom,mdss-dsi-h-sync-skew = <0>;
				qcom,mdss-dsi-v-front-porch = <26>;
				qcom,mdss-dsi-v-back-porch = <86>;
				qcom,mdss-dsi-v-pulse-width = <4>;
				qcom,mdss-dsi-panel-framerate = <60>;
				qcom,mdss-dsi-panel-phy-timings= [00 20 08 08 18 23 08
			08 08 02 04 00 1B 0D];
				qcom,display-topology  = <1 0 1>;
				qcom,default-topology-index  = <0>;
				qcom,mdss-dsi-on-command = [15 01 00 00 00 00 02 FF 20
			15 01 00 00 00 00 02 FB 01
			39 01 00 00 00 00 11 B0 00 08 00 28 00 58 00 7C 00 9A 00 B4 00 CA 00 DE
			39 01 00 00 00 00 11 B1 00 EE 01 27 01 53 01 94 01 C3 02 0C 02 48 02 4A
			39 01 00 00 00 00 11 B2 02 80 02 BB 02 E4 03 17 03 3A 03 67 03 75 03 83
			39 01 00 00 00 00 0D B3 03 95 03 A8 03 BB 03 CE 03 DF 03 E1
			39 01 00 00 00 00 11 B4 00 08 00 28 00 58 00 7C 00 9A 00 B4 00 CA 00 DE
			39 01 00 00 00 00 11 B5 00 EE 01 27 01 53 01 94 01 C3 02 0C 02 48 02 4A
			39 01 00 00 00 00 11 B6 02 80 02 BB 02 E4 03 17 03 3A 03 67 03 75 03 83
			39 01 00 00 00 00 0D B7 03 95 03 A8 03 BB 03 CE 03 DF 03 E1
			39 01 00 00 00 00 11 B8 00 08 00 28 00 58 00 7C 00 9A 00 B4 00 CA 00 DE
			39 01 00 00 00 00 11 B9 00 EE 01 27 01 53 01 94 01 C3 02 0C 02 48 02 4A
			39 01 00 00 00 00 11 BA 02 80 02 BB 02 E4 03 17 03 3A 03 67 03 75 03 83
			39 01 00 00 00 00 0D BB 03 95 03 A8 03 BB 03 CE 03 DF 03 E1
			15 01 00 00 00 00 02 C6 11
			15 01 00 00 00 00 02 C7 11
			15 01 00 00 00 00 02 C8 11
			15 01 00 00 00 00 02 C9 11
			15 01 00 00 00 00 02 CA 11
			15 01 00 00 00 00 02 CB 11
			15 01 00 00 00 00 02 CC 11
			15 01 00 00 00 00 02 CD 11
			15 01 00 00 00 00 02 CE 11
			15 01 00 00 00 00 02 CF 11
			15 01 00 00 00 00 02 D0 11
			15 01 00 00 00 00 02 D1 11
			15 01 00 00 00 00 02 D2 11
			15 01 00 00 00 00 02 D3 11
			15 01 00 00 00 00 02 D4 11
			15 01 00 00 00 00 02 D5 11
			15 01 00 00 00 00 02 D6 11
			15 01 00 00 00 00 02 D7 11
			15 01 00 00 00 00 02 D8 11
			15 01 00 00 00 00 02 D9 11
			15 01 00 00 00 00 02 DA 11
			15 01 00 00 00 00 02 DB 11
			15 01 00 00 00 00 02 DC 11
			15 01 00 00 00 00 02 DD 11
			15 01 00 00 00 00 02 DE 11
			15 01 00 00 00 00 02 DF 11
			15 01 00 00 00 00 02 E0 11
			15 01 00 00 00 00 02 E1 11
			15 01 00 00 00 00 02 E2 11
			15 01 00 00 00 00 02 E3 11
			15 01 00 00 00 00 02 FF 21
			15 01 00 00 00 00 02 FB 01
			39 01 00 00 00 00 11 B0 00 00 00 20 00 50 00 74 00 92 00 AC 00 C2 00 D6
			39 01 00 00 00 00 11 B1 00 E6 01 1F 01 4B 01 8C 01 BB 02 04 02 40 02 42
			39 01 00 00 00 00 11 B2 02 78 02 B3 02 DC 03 0F 03 32 03 5F 03 6D 03 7B
			39 01 00 00 00 00 0D B3 03 8D 03 A0 03 B3 03 C6 03 D7 03 D9
			39 01 00 00 00 00 11 B4 00 00 00 20 00 50 00 74 00 92 00 AC 00 C2 00 D6
			39 01 00 00 00 00 11 B5 00 E6 01 1F 01 4B 01 8C 01 BB 02 04 02 40 02 42
			39 01 00 00 00 00 11 B6 02 78 02 B3 02 DC 03 0F 03 32 03 5F 03 6D 03 7B
			39 01 00 00 00 00 0D B7 03 8D 03 A0 03 B3 03 C6 03 D7 03 D9
			39 01 00 00 00 00 11 B8 00 00 00 20 00 50 00 74 00 92 00 AC 00 C2 00 D6
			39 01 00 00 00 00 11 B9 00 E6 01 1F 01 4B 01 8C 01 BB 02 04 02 40 02 42
			39 01 00 00 00 00 11 BA 02 78 02 B3 02 DC 03 0F 03 32 03 5F 03 6D 03 7B
			39 01 00 00 00 00 0D BB 03 8D 03 A0 03 B3 03 C6 03 D7 03 D9
			15 01 00 00 00 00 02 FF 20
			15 01 00 00 00 00 02 FB 01
			15 01 00 00 00 00 02 30 11
			15 01 00 00 00 00 02 6D AA
			15 01 00 00 00 00 02 75 A2
			15 01 00 00 00 00 02 77 B3
			15 01 00 00 00 00 02 FF 24
			15 01 00 00 00 00 02 FB 01
			15 01 00 00 00 00 02 3A 5D
			15 01 00 00 00 00 02 3B 60
			15 01 00 00 00 00 02 4A 5D
			15 01 00 00 00 00 02 4B 60
			15 01 00 00 00 00 02 5A 60
			15 01 00 00 00 00 02 5B 60
			39 01 00 00 00 00 03 5E 00 06
			15 01 00 00 00 00 02 C4 20
			15 01 00 00 00 00 02 C5 01
			15 01 00 00 00 00 02 C7 08
			15 01 00 00 00 00 02 C8 08
			39 01 00 00 00 00 0D B6 0F 00 0F 00 00 00 00 00 0F 0F 00 00
			15 01 00 00 00 00 02 91 44
			15 01 00 00 00 00 02 92 72
			15 01 00 00 00 00 02 94 5A
			15 01 00 00 00 00 02 DC 72
			15 01 00 00 00 00 02 E0 72
			15 01 00 00 00 00 02 E2 72
			15 01 00 00 00 00 02 E4 72
			15 01 00 00 00 00 02 E6 72
			15 01 00 00 00 00 02 FF 25
			15 01 00 00 00 00 02 FB 01
			15 01 00 00 00 00 02 1F 60
			15 01 00 00 00 00 02 20 60
			15 01 00 00 00 00 02 26 60
			15 01 00 00 00 00 02 27 60
			15 01 00 00 00 00 02 33 60
			15 01 00 00 00 00 02 34 60
			15 01 00 00 00 00 02 48 60
			15 01 00 00 00 00 02 49 60
			15 01 00 00 00 00 02 5B 00
			15 01 00 00 00 00 02 61 60
			15 01 00 00 00 00 02 62 60
			15 01 00 00 00 00 02 FF 26
			15 01 00 00 00 00 02 FB 01
			15 01 00 00 00 00 02 02 31
			15 01 00 00 00 00 02 04 50
			15 01 00 00 00 00 02 06 3C
			15 01 00 00 00 00 02 0C 15
			15 01 00 00 00 00 02 0D 0B
			15 01 00 00 00 00 02 13 44
			15 01 00 00 00 00 02 14 5C
			15 01 00 00 00 00 02 19 10
			15 01 00 00 00 00 02 1A E0
			15 01 00 00 00 00 02 1B 0F
			15 01 00 00 00 00 02 1C E0
			15 01 00 00 00 00 02 2A 10
			15 01 00 00 00 00 02 2B E0
			15 01 00 00 00 00 02 1E 72
			15 01 00 00 00 00 02 1F 72
			15 01 00 00 00 00 02 25 72
			15 01 00 00 00 00 02 30 72
			15 01 00 00 00 00 02 31 05
			15 01 00 00 00 00 02 32 8A
			15 01 00 00 00 00 02 39 00
			15 01 00 00 00 00 02 3A 72
			15 01 00 00 00 00 02 FF 27
			15 01 00 00 00 00 02 FB 01
			15 01 00 00 00 00 02 59 5E
			15 01 00 00 00 00 02 5B 18
			15 01 00 00 00 00 02 5D 06
			15 01 00 00 00 00 02 61 25
			15 01 00 00 00 00 02 64 21
			15 01 00 00 00 00 02 68 22
			15 01 00 00 00 00 02 D2 53
			15 01 00 00 00 00 02 FF 2A
			15 01 00 00 00 00 02 FB 01
			15 01 00 00 00 00 02 25 72
			15 01 00 00 00 00 02 F1 04
			15 01 00 00 00 00 02 FF E0
			15 01 00 00 00 00 02 FB 01
			15 01 00 00 00 00 02 14 60
			15 01 00 00 00 00 02 16 C0
			15 01 00 00 00 00 02 FF F0
			15 01 00 00 00 00 02 FB 01
			15 01 00 00 00 00 02 3A 08
			15 01 00 00 00 00 02 FF 10
			15 01 00 00 00 00 02 FB 01
			15 01 00 00 00 00 02 B9 01
			15 01 00 00 00 00 02 FF 20
			15 01 00 00 00 00 02 FB 01
			15 01 00 00 00 00 02 18 40
			15 01 00 00 00 00 02 FF 10
			15 01 00 00 00 00 02 FB 01
			15 01 00 00 00 00 02 B9 02
			15 01 00 00 00 00 02 35 00
			15 01 00 00 00 00 02 BB 13
			39 01 00 00 00 00 06 3B 03 5A 1A 04 04
			15 01 00 00 00 00 02 FF 10
			15 01 00 00 00 00 02 FB 01
			05 01 00 00 78 00 01 11
			05 01 00 00 14 00 01 29
			15 01 00 00 00 00 02 FF 27
			15 01 00 00 00 00 02 FB 01
			15 01 00 00 00 00 02 D0 11
			15 01 00 00 00 00 02 D2 50
			15 01 00 00 00 00 02 DE 43
			15 01 00 00 00 00 02 DF 0A
			15 01 00 00 00 00 02 FF F0
			15 01 00 00 00 00 02 FB 01
			15 01 00 00 00 00 02 84 08
			15 01 00 00 00 00 02 85 0C
			15 01 00 00 00 00 02 FF 20
			15 01 00 00 00 00 02 FB 01
			15 01 00 00 00 00 02 51 10
			15 01 00 00 00 00 02 FF 25
			15 01 00 00 00 00 02 FB 01
			15 01 00 00 00 00 02 91 1F
			15 01 00 00 00 00 02 92 0F
			15 01 00 00 00 00 02 93 01
			15 01 00 00 00 00 02 94 18
			15 01 00 00 00 00 02 95 03
			15 01 00 00 00 00 02 96 01];
				qcom,mdss-dsi-on-command-state = "dsi_lp_mode";
				qcom,mdss-dsi-off-command = [15 01 00 00 00 00 02 FF 10
			15 01 00 00 00 00 02 FB 01
			05 01 00 00 20 00 01 28
			05 01 00 00 78 00 01 10];
				qcom,mdss-dsi-off-command-state = "dsi_lp_mode";
			};
		};
    };
};