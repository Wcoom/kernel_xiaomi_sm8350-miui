/*---------------------------------------------------------------------------
 * This file is autogenerated file using huawei LCD parser. Please do not edit it.
 * Update input XML file to add a new entry or update variable in this file
 * Parser location: vendor/huawei/chipset_common/devkit/lcdkit/tools 
 *---------------------------------------------------------------------------*/


#include "nco_110_a08_6p67_qcom.dtsi"
#include "nco_190_c06_6p67_qcom.dtsi"
#include "nco_290_f00_6p67_qcom.dtsi"
#include "nco_310_c06_6p67_qcom.dtsi"
#include "nco_auo_otm1901a_5p2_1080p_video_default.dtsi"