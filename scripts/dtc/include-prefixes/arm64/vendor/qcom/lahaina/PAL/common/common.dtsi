#include "../../common/common.dtsi"
#include "huawei_audio.dtsi"
#include "huawei_fp.dtsi"
#include "huawei_cpld.dtsi"
#include "huawei_bsp.dtsi"
#include "huawei_charger.dtsi"
#include "huawei_dp.dtsi"
#include "huawei_ir.dtsi"
#include "huawei-sensor.dtsi"
#include "huawei_mmc.dtsi"
#include "huawei_tp.dtsi"
#include "huawei_fac.dtsi"
#include "huawei_gpio.dtsi"
#include "huawei_usb.dtsi"
#include "huawei_connectivity.dtsi"
#include "huawei-lcd.dtsi"

&drop_sensor_enable {
    compatible = "huawei,sensorhub_drop";
    enable_drop = "1";
};

&sensorhub_ext_config {
    compatible = "huawei,sensorhub";
    acc_sensor_id = "1 65558";// acc:1;  acc1:65558:65558=0x10016
    gyro_sensor_id = "4 65559";// gyro:4; gyro1:65559:65559=0x10017
};

&als_after_sale_TCS3718ALSPRX {
    compatible = "TCS3718ALSPRX";
    als_after_sale_product = <28>;
    als_after_sale_xl = <1835>;
    als_after_sale_yl = <38>;
    als_after_sale_xr = <1935>;
    als_after_sale_yr = <138>;
    als_after_sale_gamma = <0>;
	190_207 = "1885,88,1,0,218,184,168,131,112,81,65,31,5";
	default = "1885,88,1,0,218,184,168,131,112,81,65,31,5";
};
