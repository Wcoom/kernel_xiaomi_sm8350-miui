#include "../../../lcdkit3.0/got/devkit_lcd_kit.dtsi"
&huawei_lcd_panel {
	compatible = "huawei,lcd_panel_type";
	/* auto_key_info @ name: product_id type: uint32 default: 0 */
	product_id = <7100>;
	/* auto_key_info @ name: lcd_kit_power_ctrl type: uint32 default: 0 */
	lcd_kit_power_ctrl = <1>;
	/* auto_key_info @ name: gpio_id[2] type: int default: 0 */
	gpio_id = <28 29>;
	/* auto_key_info @ name: lcd_reset_gpio type: uint32 default: 0 */
	lcd_reset_gpio = <24>;
	/* auto_key_info @ name: te_gpio type: uint32 default: 0 */
	te_gpio = <82>;
	/* auto_key_info @ name: iovcc_gpio type: uint32 default: 0 */
	iovcc_gpio = <126>;
        /* auto_key_info @ name: bias_ctrl_type type: uint32 default: 0 */
        bias_ctrl_type = <7>;
	support_lcd_type = "LCD_KIT";
};
